## code/esp_code/main/Kconfig.projbuild
```kconfig
menu "X-WING Config"

    menu "sensors config"
        menu "communication protocols config"
            config I2C0_PIN_SDA
                int "I2C0_PIN_SDA GPIO number"
                range 0 43
                default 11
                help
                    GPIO number (IOxx) I2C0_PIN_SDA

            config I2C0_PIN_SCL
                int "I2C0_PIN_SCL GPIO number"
                range 0 43
                default 10
                help
                    GPIO number (IOxx) I2C0_PIN_SCL

            config I2C1_PIN_SDA
                int "I2C1_PIN_SDA GPIO number"
                range 0 43
                default 40
                help
                    GPIO number (IOxx) I2C1_PIN_SDA

            config I2C1_PIN_SCL
                int "I2C1_PIN_SCL GPIO number"
                range 0 43
                default 41
                help
                    GPIO number (IOxx) I2C1_PIN_SCL

            config SPI_PIN_MISO
                int "SPI_PIN_MISO GPIO number"
                range 0 43
                default 37
                help
                    GPIO number (IOxx) SPI_PIN_MISO

            config SPI_PIN_MOSI
                int "SPI_PIN_MOSI GPIO number"
                range 0 43
                default 35
                help
                    GPIO number (IOxx) SPI_PIN_MOSI

            config SPI_PIN_CLK
                int "SPI_PIN_CLK GPIO number"
                range 0 43
                default 36
                help
                    GPIO number (IOxx) SPI_PIN_CLK

            config SPI_PIN_CS0
                int "SPI_PIN_CS0 GPIO number"
                range 0 43
                default 34
                help
                    GPIO number (IOxx) SPI_PIN_CS0

            config MPU_PIN_INT
                int "MPU_PIN_INT GPIO number"
                range 0 43
                default 12
                help
                    GPIO number (IOxx) MPU_PIN_INT

            config ADC1_PIN
                int "EXT01_PIN GPIO number"
                range 1 10
                default 2
                help
                    GPIO number (IOxx) ADC1_PIN

            config EXT01_PIN
                int "EXT01_PIN GPIO number"
                range 0 43
                default 1
                help
                    GPIO number (IOxx) EXT01_PIN
        endmenu

        menu "led config"
            config LED_PIN_ESP
                int "LED_PIN_ESP GPIO number"
                range 0 43
                default 15
                help
                    GPIO number (IOxx) LED_PIN_ESP

            config LED_PIN_BLUE
                int "LED_PIN_BLUE GPIO number"
                range 0 43
                default 7
                help
                    GPIO number (IOxx) LED_PIN_BLUE

            config LED_PIN_GREEN
                int "LED_PIN_GREEN GPIO number"
                range 0 43
                default 9
                help
                    GPIO number (IOxx) LED_PIN_GREEN

            config LED_PIN_RED
                int "LED_PIN_RED GPIO number"
                range 0 43
                default 8
                help
                    GPIO number (IOxx) LED_PIN_RED

        endmenu

        menu "motors config"
            config MOTOR01_PIN
                int "MOTOR01_PIN GPIO number"
                range 0 43
                default 5
                help
                    GPIO number (IOxx) MOTOR01_PIN

            config MOTOR02_PIN
                int "MOTOR02_PIN GPIO number"
                range 0 43
                default 6
                help
                    GPIO number (IOxx) MOTOR02_PIN

            config MOTOR03_PIN
                int "MOTOR03_PIN GPIO number"
                range 0 43
                default 3
                help
                    GPIO number (IOxx) MOTOR03_PIN

            config MOTOR04_PIN
                int "MOTOR04_PIN GPIO number"
                range 0 43
                default 4
                help
                    GPIO number (IOxx) MOTOR04_PIN
        endmenu
    endmenu

    menu "flying parameter configuration"
        config HOVERING_H
            int "default high of hovering(cm)"
            range 0 150
            default 50
        
        config VEL_MAX
            int "Max velocity of the drone"
            range 0 10
            default 2
        
        config LAND_ON_SITE
            bool "Where the drone will land, (on site[*] - odom[])"
            default y

        
    endmenu

    menu "tasks settings (prio / stack size)"

        config SYSTEM_TASK_STACK
            int "Stack the sytem (Bytes)"
            default 4000
            help
                Stack size in Bytes of the system task

        config SYSTEM_TASK_PRIO
            int "Priority of the system"
            default 4
            help
                Priority of the system task, higher value means higher priority

        config IMU_TASK_STACK
            int "Stack the imu (Bytes)"
            default 3200
            help
                Stack size in Bytes of the IMU task

        config IMU_TASK_PRIO
            int "Priority of the imu task"
            default 7
            help
                Priority of imu task, higher value means higher priority

        config HEIGHT_TASK_STACK
            int "Stack the height (Bytes)"
            default 3200
            help
                Stack size in Bytes of the Height task

        config HEIGHT_TASK_PRIO
            int "Priority of the height task"
            default 5
            help
                Priority of height task, higher value means higher priority

        config ODOM_TASK_STACK
            int "Stack the odom (Bytes)"
            default 3200
            help
                Stack size in Bytes of the Odom task

        config ODOM_TASK_PRIO
            int "Priority of the odom task"
            default 5
            help
                Priority of odom task, higher value means higher priority

        config ATTITUDE_TASK_STACK
            int "Stack the odom (Bytes)"
            default 4900
            help
                Stack size in Bytes of the Attitude task

        config ATTITUDE_TASK_PRIO
            int "Priority of the attitude task"
            default 6
            help
                Priority of attitude task, higher value means higher priority

        config TUNING_TASK_STACK
            int "Stack the tuning task (Bytes)"
            default 3072
            help
                Stack size in Bytes of the tuning task (change the gains
                from the serial console while running)

        config TUNING_TASK_PRIO
            int "Priority of the tuning task"
            default 1
            help
                Priority of the tuning task. Keep it low so it never
                delays the control tasks

        config MICRO_ROS_STACK
            int "Stack the micro-ROS app (Bytes)"
            default 8000
            help
                Stack size in Bytes of the micro-ROS app. Measured with the
                CPU log (Diagnostics): it uses ~2.5 KB in simulation

        config MICRO_ROS_TASK_PRIO
            int "Priority of the micro-ROS app"
            default 3
            help
                Priority of micro-ros task, higher value means higher priority.
                Under the control tasks: they only use ~1 ms of every period,
                so micro-ROS gets the sensors (simulation) and publishes the
                motors at most 1-2 ms later, but it never delays the control
    endmenu

    menu "Simulation"
        config SIMULATION_ON
            bool "Simulation on"
            default n
            help
                If simulation is on, will be some extra ROS subscribers and 
                publisher to emulate the sensors and motors

    endmenu

    menu "Tunning"
        config GAINS_TUNE_ON
            bool "Gains tune on"
            default n
            help
                If gains tune is on, the monitor will allow to change the gains while flying
    endmenu

    menu "Diagnostics"
        config CPU_STATS_ON
            bool "CPU usage and task period log"
            default n
            select FREERTOS_USE_TRACE_FACILITY
            select FREERTOS_GENERATE_RUN_TIME_STATS
            help
                Writes in the log, every CPU_STATS_PERIOD_MS, the CPU time of
                every task and the real period of the drone tasks. Save the
                monitor (idf.py monitor | tee log.txt) and analyse it with
                tools/analyze_cpu.py.

        config CPU_STATS_PERIOD_MS
            int "Time between two logs (ms)"
            depends on CPU_STATS_ON
            range 500 60000
            default 2000
            help
                Window of the measures. Shorter gives more detail in the
                graphs but more lines in the log.
    endmenu

endmenu
```
