## code/esp_code/main/Kconfig.projbuild
```kconfig
menu "Drone Config"

    menu "sensors config"
        menu "communication protocols config"
            config I2C0_PIN_SDA
                int "I2C0_PIN_SDA GPIO number"
                range 0 43
                default 11
                help
                    GPIO number (IOxx) I2C0_PIN_SDA

            config I2C0_PIN_SCL
                int "I2C0_PIN_SCL GPIO number"
                range 0 43
                default 10
                help
                    GPIO number (IOxx) I2C0_PIN_SCL

            config I2C1_PIN_SDA
                int "I2C1_PIN_SDA GPIO number"
                range 0 43
                default 40
                help
                    GPIO number (IOxx) I2C1_PIN_SDA

            config I2C1_PIN_SCL
                int "I2C1_PIN_SCL GPIO number"
                range 0 43
                default 41
                help
                    GPIO number (IOxx) I2C1_PIN_SCL

            config SPI_PIN_MISO
                int "SPI_PIN_MISO GPIO number"
                range 0 43
                default 37
                help
                    GPIO number (IOxx) SPI_PIN_MISO

            config SPI_PIN_MOSI
                int "SPI_PIN_MOSI GPIO number"
                range 0 43
                default 35
                help
                    GPIO number (IOxx) SPI_PIN_MOSI

            config SPI_PIN_CLK
                int "SPI_PIN_CLK GPIO number"
                range 0 43
                default 36
                help
                    GPIO number (IOxx) SPI_PIN_CLK

            config SPI_PIN_CS0
                int "SPI_PIN_CS0 GPIO number"
                range 0 43
                default 34
                help
                    GPIO number (IOxx) SPI_PIN_CS0

            config MPU_PIN_INT
                int "MPU_PIN_INT GPIO number"
                range 0 43
                default 12
                help
                    GPIO number (IOxx) MPU_PIN_INT

            config ADC1_PIN
                int "EXT01_PIN GPIO number"
                range 1 10
                default 2
                help
                    GPIO number (IOxx) ADC1_PIN

            config EXT01_PIN
                int "EXT01_PIN GPIO number"
                range 0 43
                default 1
                help
                    GPIO number (IOxx) EXT01_PIN
        endmenu

        menu "led config"
            config LED_PIN_ESP
                int "LED_PIN_ESP GPIO number"
                range 0 43
                default 15
                help
                    GPIO number (IOxx) LED_PIN_ESP

            config LED_PIN_BLUE
                int "LED_PIN_BLUE GPIO number"
                range 0 43
                default 7
                help
                    GPIO number (IOxx) LED_PIN_BLUE

            config LED_PIN_GREEN
                int "LED_PIN_GREEN GPIO number"
                range 0 43
                default 9
                help
                    GPIO number (IOxx) LED_PIN_GREEN

            config LED_PIN_RED
                int "LED_PIN_RED GPIO number"
                range 0 43
                default 8
                help
                    GPIO number (IOxx) LED_PIN_RED

        endmenu

        menu "motors config"
            config MOTOR01_PIN
                int "MOTOR01_PIN GPIO number"
                range 0 43
                default 5
                help
                    GPIO number (IOxx) MOTOR01_PIN

            config MOTOR02_PIN
                int "MOTOR02_PIN GPIO number"
                range 0 43
                default 6
                help
                    GPIO number (IOxx) MOTOR02_PIN

            config MOTOR03_PIN
                int "MOTOR03_PIN GPIO number"
                range 0 43
                default 3
                help
                    GPIO number (IOxx) MOTOR03_PIN

            config MOTOR04_PIN
                int "MOTOR04_PIN GPIO number"
                range 0 43
                default 4
                help
                    GPIO number (IOxx) MOTOR04_PIN
        endmenu
    endmenu

    menu "flying parameter configuration"
        config FLIGHT_H_MIN
            int "Min altitude (cm)"
            range 0 1000
            default 50
            help
                A altitude request below this altitude is rejected

        config FLIGHT_H_MAX
            int "Max altitude (cm)"
            range 0 1000
            default 300
            help
                A altitude request above this altitude is rejected

        config VEL_MAX
            int "Max horizontal velocity of the drone (cm/s)"
            range 0 1000
            default 50
            help
                The horizontal velocity of cmd_vel (module of linear.x, linear.y) is
                limited to this value. It can be changed at runtime (v_max of drone/params)


    endmenu

    menu "system config"
        config IMU_TIMEOUT
            int "Maximum time without new IMU data before starting the failsafe (ms)"
            range 1 1000
            default 300
            help
                In simulation 300 ms = 20 samples. In real drone 100 ms = 20 samples 
                
        config BARO_TIMEOUT
            int "Maximum time without new Barometer data before starting the failsafe (ms)"
            range 1 1000
            default 500

        config LINK_TIMEOUT
            int "Maximum time without link with the micro-ROS agent before starting the failsafe (ms)"
            range 500 10000
            default 1500
            help
                Only real drone: it pings the agent every 500 ms (3 pings with
                the default). Then it lands with its sensors and goes to ERROR.
                In simulation the IMU timeout detects the lost link.
    endmenu

    menu "controller config"
        config ALPHA
            int "ALPHA value for the complementary filter (x100)"
            range 0 100
            default 98

        config MAX_TILT_ANGLE
            int "Maximum tilt angle (x100, rad, 0-157)"
            range 0 157
            default 35

        config MAX_POWER_RATE
            int "Maximum target roll/pitch rate (deg/s) (0-1000)"
            range 0 1000
            default 200

        config MAX_POWER_RP
            int "Max power of each roll/pitch term"
            range 0 1000
            default 400

        config MAX_POWER_YAW
            int "Maximum power of yaw term"
            range 0 1000
            default 150

        config THROTTLE_BASE
            int "Throttle to hover (rad/s, 0-3000)"
            range 0 3000
            default 2378

        config PITCH_DEVIATION
            int "Value to correct the deviation in pitch (x10)"
            range 0 1000
            default 105
            help
                In simulation is 105(10.5), In real drone is X

        config ROLL_DEVIATION
            int "Value to correct the deviation in roll (x10)"
            range 0 1000
            default 0
            help
                Start value of the roll integral, like PITCH_DEVIATION. 0 = no correction

        menu "Gains"
            comment "Decimal values are x1000 (e.g. 1500 = 1.5)"
            config KP_H
                int "KP_H x1000: height error (m) -> power"
                default 100000

            config KD_H
                int "KD_H x1000: vertical velocity (m/s) -> power"
                default 110000

            config KP_VEL
                int "KP_VEL x1000: velocity error (m/s) -> target roll/pitch (rad)"
                default 50

            config KP_ANGLE
                int "KP_ANGLE x1000: angle error (deg) -> target rate (deg/s)"
                default 1500

            config KP_RATE
                int "KP_RATE x1000: rate error (deg/s) -> power"
                default 300

            config KI_RATE
                int "KI_RATE x1000: integral of the rate error -> power"
                default 600

            config KP_YAW_RATE
                int "KP_YAW_RATE x1000: yaw rate error (deg/s) -> power"
                default 3000
        endmenu

    endmenu

    menu "odometry config"
        config K_DRAG
            int "K_DRAG x1000: rotor drag (1/s), a_body = -K_DRAG * v_body"
            range 1 100000
            default 124
            help
                Identified in simulation (rosbag 15/10: 0.124 1/s). Identify
                it again in the real drone
    endmenu

    menu "tasks settings (prio / stack size)"

        config SYSTEM_TASK_STACK
            int "Stack the sytem (Bytes)"
            default 4000
            help
                Stack size in Bytes of the system task

        config SYSTEM_TASK_PRIO
            int "Priority of the system"
            default 4
            help
                Priority of the system task, higher value means higher priority

        config IMU_TASK_STACK
            int "Stack the imu (Bytes)"
            default 3200
            help
                Stack size in Bytes of the IMU task

        config IMU_TASK_PRIO
            int "Priority of the imu task"
            default 7
            help
                Priority of imu task, higher value means higher priority

        config HEIGHT_TASK_STACK
            int "Stack the height (Bytes)"
            default 3200
            help
                Stack size in Bytes of the Height task

        config HEIGHT_TASK_PRIO
            int "Priority of the height task"
            default 5
            help
                Priority of height task, higher value means higher priority

        config ODOM_TASK_STACK
            int "Stack the odom (Bytes)"
            default 3200
            help
                Stack size in Bytes of the Odom task

        config ODOM_TASK_PRIO
            int "Priority of the odom task"
            default 5
            help
                Priority of odom task, higher value means higher priority

        config ATTITUDE_TASK_STACK
            int "Stack the odom (Bytes)"
            default 4900
            help
                Stack size in Bytes of the Attitude task

        config ATTITUDE_TASK_PRIO
            int "Priority of the attitude task"
            default 6
            help
                Priority of attitude task, higher value means higher priority

        config TUNING_TASK_STACK
            int "Stack the tuning task (Bytes)"
            default 3072
            help
                Stack size in Bytes of the tuning task (change the gains
                from the serial console while running)

        config TUNING_TASK_PRIO
            int "Priority of the tuning task"
            default 1
            help
                Priority of the tuning task. Keep it low so it never
                delays the control tasks

        config MICRO_ROS_STACK
            int "Stack the micro-ROS app (Bytes)"
            default 8000
            help
                Stack size in Bytes of the micro-ROS app. Measured with the
                CPU log (Diagnostics): it uses ~2.5 KB in simulation

        config MICRO_ROS_TASK_PRIO
            int "Priority of the micro-ROS app"
            default 3
            help
                Priority of micro-ros task, higher value means higher priority.
                Under the control tasks: they only use ~1 ms of every period,
                so micro-ROS gets the sensors (simulation) and publishes the
                motors at most 1-2 ms later, but it never delays the control
    endmenu

    menu "Simulation"
        comment "Turn on this configuration if you want to use the simulation. Will be some extra ROS publisher and subscribers to emulate the sensors and motors"
        
        config SIMULATION_ON
            bool "Simulation on"
            default n
            help
                If simulation is on, will be some extra ROS subscribers and 
                publisher to emulate the sensors and motors

    endmenu

    menu "Tunning"
        comment "Turn on this configuration if you want to use the gain tune. This allows to tune the gains through the esp-idf monitor"
        config GAINS_TUNE_ON
            bool "Gains tune on"
            default n
            help
                If gains tune is on, the monitor will allow to change the gains while flying
    endmenu

    menu "Diagnostics"
        config CPU_STATS_ON
            bool "CPU usage and task period log"
            default n
            select FREERTOS_USE_TRACE_FACILITY
            select FREERTOS_GENERATE_RUN_TIME_STATS
            help
                Writes in the log, every CPU_STATS_PERIOD_MS, the CPU time of
                every task and the real period of the drone tasks. Save the
                monitor (idf.py monitor | tee log.txt) and analyse it with
                tools/analyze_cpu.py.

        config CPU_STATS_PERIOD_MS
            int "Time between two logs (ms)"
            depends on CPU_STATS_ON
            range 500 60000
            default 2000
            help
                Window of the measures. Shorter gives more detail in the
                graphs but more lines in the log.
    endmenu

endmenu
```
